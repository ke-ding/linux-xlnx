/*
 * CAUTION: This file is automatically generated by Xilinx.
 * Version:  
 * Today is: Thu Jan 31 15:34:05 2019
 */


&axi_ethernet1 {
	local-mac-address = [00 0a 35 00 00 00];
};
&axi_ethernet2 {
	local-mac-address = [00 0a 35 00 00 01];
};
&axi_ethernet_sfp0 {
	local-mac-address = [00 0a 35 00 00 02];
};
&gem0 {
	local-mac-address = [00 0a 35 00 00 03];
};
