/*
 * CAUTION: This file is automatically generated by Xilinx.
 * Version:  
 * Today is: Thu Jan 31 15:34:05 2019
 */


/dts-v1/;
/include/ "zynq-7000.dtsi"
/include/ "pl.dtsi"
/include/ "pcw.dtsi"
/include/ "system.dts"
/ {
	chosen {
		bootargs = "root=/dev/ram rw;earlycon";
		stdout-path = "serial0:115200n8";
	};
	aliases {
		ethernet1 = &axi_ethernet1;
		ethernet2 = &axi_ethernet2;
		ethernet3 = &axi_ethernet_sfp0;
		ethernet0 = &gem0;
		serial0 = &uart1;
	};
	memory {
		device_type = "memory";
		reg = <0x0 0x40000000>;
	};
};
